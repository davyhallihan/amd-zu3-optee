## zu3_optee/project-spec/configs/configs/Kconfig
```kconfig
mainmenu "PetaLinux System Configuration"
config SUBSYSTEM_TYPE_LINUX
        bool
        default y
        select SYSTEM_ZYNQMP

config SYSTEM_ZYNQMP
        bool "ZYNQMP Configuration"
        help
          ZYNQMP Configuration for the project.
          All these config options will be in /home/davy/research/optee/zup_pl_project/zu3_optee/project-spec/configs/config

config SUBSYSTEM_VARIANT_ZYNQMPEG
        bool
        default y
        help

config SUBSYSTEM_DISTRO_PETALINUX
        bool
        default y
        help

source /home/davy/research/optee/zup_pl_project/zu3_optee/project-spec/configs/configs/Kconfig.main
```

## zu3_optee/project-spec/configs/rootfsconfigs/Kconfig.user
```kconfig
menu "user packages " 
config gpio-demo  
	 bool "gpio-demo"
	 help
	
config optee-client  
	 bool "optee-client"
	 help
	
config optee-examples  
	 bool "optee-examples"
	 help
	
config optee-os  
	 bool "optee-os"
	 help
	
config optee-test  
	 bool "optee-test"
	 help
	
config peekpoke  
	 bool "peekpoke"
	 help
	
endmenu
```
